## conf/layer.conf
```bitbake
# We have a conf and classes directory, add to BBPATH
BBPATH .= ":${LAYERDIR}"

# We have a packages directory, add to BBFILES
BBFILES += "${LAYERDIR}/recipes-*/*/*.bb \
            ${LAYERDIR}/recipes-*/*/*.bbappend"

BBFILE_COLLECTIONS += "freescale-extra"
BBFILE_PATTERN_freescale-extra := "^${LAYERDIR}/"
BBFILE_PRIORITY_freescale-extra = "4"

LAYERDEPENDS_freescale-extra = "core fsl"
```
